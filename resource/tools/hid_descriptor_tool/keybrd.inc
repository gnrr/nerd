        db  5h,  1h                ; USAGE_PAGE (Generic Desktop)
        db  9h,  6h                ; USAGE (Keyboard)
        db a1h,  1h                ; COLLECTION (Application)
        db  5h,  7h                ;   USAGE_PAGE (Keyboard)
        db 19h, e0h                ;   USAGE_MINIMUM (Keyboard LeftControl)
        db 29h, e7h                ;   USAGE_MAXIMUM (Keyboard Right GUI)
        db 15h,  0h                ;   LOGICAL_MINIMUM (0)
        db 25h,  1h                ;   LOGICAL_MAXIMUM (1)
        db 75h,  1h                ;   REPORT_SIZE (1)
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        db 81h,  0h                ;   INPUT (Data,Ary,Abs)
        db c0h                     ; END_COLLECTION
